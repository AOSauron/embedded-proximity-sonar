## display-driver/Config.in
```kconfig
config BR2_PACKAGE_DISPLAYDRIVER
    bool displaydriver
        help
            Pilote du triple afficher sept segments par Guillaume Garcia & Alexandre V. Jamet <3
```

## proximity-sonar-driver/Config.in
```kconfig
config BR2_PACKAGE_PROXIMITYSONARDRIVER
    bool proxmitysonardriver
        help
            Pilote du capteur de proximite par Guillaume Garcia & Alexandre V. Jamet <3
```

## sonar-display-user-interface/Config.in
```kconfig
config BR2_PACKAGE_SONARDISPLAYUSERINTERFACE
	bool SonarDisplayUserInterface
		help
			User interfrace between 7-segments displayer and the sonar
```
